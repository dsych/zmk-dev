#include "skeletyl.dtsi" // Notice that the main dtsi files are included in the overlay.

&kscan0 {
    col-gpios
        = <&xiao_d 10 GPIO_ACTIVE_HIGH> // Row A from the schematic file
        , <&xiao_d 9 GPIO_ACTIVE_HIGH> // Row B from the schematic file
        , <&xiao_d 8 GPIO_ACTIVE_HIGH> // Row D from the schematic file
        , <&xiao_d 5 GPIO_ACTIVE_HIGH> // Row C from the schematic file
        , <&xiao_d 4 GPIO_ACTIVE_HIGH> // Row E from the schematic file
        , <&xiao_d 3 GPIO_ACTIVE_HIGH> // Row E from the schematic file
        ;

    row-gpios
        = <&xiao_d 0 (GPIO_ACTIVE_HIGH | GPIO_PULL_DOWN)> // col1 in the schematic
        , <&xiao_d 7 (GPIO_ACTIVE_HIGH | GPIO_PULL_DOWN)> // col2 in the schematic
        , <&xiao_d 2 (GPIO_ACTIVE_HIGH | GPIO_PULL_DOWN)> // col3 in the schematic
        ;
};
